## main/Kconfig.projbuild
```kconfig
menu "App Configuration"

    config WIFI_SSID
        string "Wi-Fi SSID"
        default "your-ssid"

    config WIFI_PASSWORD
        string "Wi-Fi Password"
        default "your-password"

    config MQTT_BROKER_URI
        string "MQTT Broker URI"
        default "mqtt://broker.hivemq.com:1883"

    config MQTT_USERNAME
        string "MQTT Username (optional)"
        default ""

    config MQTT_PASSWORD
        string "MQTT Password (optional)"
        default ""

    config MQTT_TOPIC_IMAGE
        string "MQTT Topic for Image (Base64)"
        default "esp32s3/camera/image"

    config MQTT_TOPIC_ALERT
        string "MQTT Topic for Alerts"
        default "esp32s3/alert"

    config DOOR_UNLOCK_MS
        int "Door unlock duration (ms)"
        range 100 10000
        default 3000

    config TILT_THRESHOLD_DEG
        int "Tilt threshold in degrees"
        range 5 45
        default 15

endmenu
```
